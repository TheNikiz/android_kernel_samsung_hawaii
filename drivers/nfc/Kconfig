## drivers/nfc/Kconfig
```kconfig
#
# Near Field Communication (NFC) devices
#

menuconfig NFC_DEVICES
	bool "Near Field Communication (NFC) devices"
	default n
	---help---
	  You'll have to say Y if your computer contains an NFC device that
	  you want to use under Linux.
	  You can say N here if you don't have any Near Field Communication devices connected to your computer.

if NFC_DEVICES

config PN544_NFC
	tristate "PN544 NFC driver"
	depends on I2C
	select CRC_CCITT
	default n
	---help---
	  Say yes if you want PN544 Near Field Communication driver.
	  This is for i2c connected version. If unsure, say N here.
	  To compile this driver as a module, choose m here. The module will be called pn544.

config BCM2079X_NFC_I2C
	tristate "BCM2079X NFC driver for I2C interface"
	depends on I2C
	default n
	---help---
	  Say yes if you want BCM2079X Near Field Communication driver.
	  This is for i2c connected version. If unsure, say N here.
	  To compile this driver as a module, choose m here. The module will be called bcm2079x-i2c.

config BCM2079X_NFC_SPI
	tristate "BCM2079X NFC driver for SPI interface"
	depends on SPI
	default n
	---help---
	  Say yes if you want BCM2079X Near Field Communication driver.
	  This is for spi connected version. If unsure, say N here.
	  To compile this driver as a module, choose m here. The module will be called bcm2079x-spi.

config SEC_NFC_I2C
    tristate "SEC NFC driver"
	depends on I2C
	default n
	---help---
	  Say yes if you want SEC Near Field Communication driver.
	  This is for i2c connected version. If unsure, say N here.

	  To compile this driver as a module, choose m here. The module will
	  be called sec-nfc.

config SEC_NFC_I2C_SB
    tristate "SEC SB NFC driver"
	depends on I2C
	default n
	---help---
	  Say yes if you want SEC Near Field Communication driver. (Secure F/W download version)
	  This is for i2c connected version. If unsure, say N here.

	  To compile this driver as a module, choose m here. The module will
	  be called sec-nfc.

config SEC_NFC_I2C_TYPE_SW
    tristate "SEC NFC I2C type (SW)"
	depends on SEC_NFC_I2C_SB
	default n
	---help---
	  Say yes if you want use S/W I2C for SEC Near Field Communication driver.
	  If unsure, say N here.

	  To compile this driver as a module, choose m here. The module will
	  be called sec-nfc.

endif # NFC_DEVICES
```

## kernel/trace/mark/Kconfig
```kconfig
#
# Samsung variant configurations.
#
# @author kumhyun.cho@samsung.com
# @since 2014.02.20

config TRACE_MARK
	bool
	default n

config TRACE_MARK_KMEM_STAT
	bool
	default n

config TRACE_MARK_MM_RSS
	bool
	default n

config TRACE_MARK_PAGE_LOCKED_KILLABLE
	bool
	default n

config TRACE_MARK_PAGE_LOCK
	bool
	default n

config TRACE_MARK_PAGE_WRITE_BACK
	bool
	default n

config TRACE_MARK_SYSCALL
	bool
	default n

config TRACE_MARK_NET_SKB_DUMP
	bool
	default n
```
